#include <SPI.h>
#include <Wire.h>
#include <Adafruit_GFX.h>
#include <Adafruit_SSD1306.h>

#define SCREEN_WIDTH 128 // pixel ความกว้าง
#define SCREEN_HEIGHT 64 // pixel ความสูง 

// กำหนดขาต่อ I2C กับจอ OLED
#define OLED_RESET -1 //ขา reset เป็น -1 ถ้าใช้ร่วมกับขา Arduino reset
Adafruit_SSD1306 OLED(SCREEN_WIDTH, SCREEN_HEIGHT, &Wire, OLED_RESET);
float Vdow = 0;
int analogPin = 0;
int raw = 0;
int Vin = 5;
float Vout = 0;
float R1 = 1000;
int R2 = 0;
float buffer = 0;
int bt = 2;
int i = 0;
// 'asa', 128x64px
const unsigned char myBitmap [] PROGMEM = {
  0x00, 0x00, 0x00, 0x00, 0x00, 0x00, 0x00, 0x00, 0x00, 0x00, 0x00, 0x00, 0x00, 0x00, 0x00, 0x00,
  0x00, 0x00, 0x00, 0x00, 0x00, 0x00, 0x00, 0x00, 0x00, 0x00, 0x00, 0x00, 0x00, 0x00, 0x00, 0x00,
  0x00, 0x00, 0x00, 0x00, 0x00, 0x00, 0x00, 0x00, 0x00, 0x00, 0x00, 0x00, 0x00, 0x00, 0x00, 0x00,
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  0x00, 0x00, 0x00, 0x00, 0x00, 0x00, 0x00, 0x00, 0x00, 0x00, 0x00, 0x00, 0x00, 0x00, 0x00, 0x00
};

void setup()
{
  pinMode(bt, INPUT);
  Serial.begin(9600);
  if (!OLED.begin(SSD1306_SWITCHCAPVCC, 0x3C)) { // สั่งให้จอ OLED เริ่มทำงานที่ Address 0x3C
    Serial.println("SSD1306 allocation failed");
  } else {
    Serial.println("ArdinoAll OLED Start Work !!!");
  }

  OLED.clearDisplay(); // ลบภาพในหน้าจอทั้งหมด
  OLED.setTextColor(WHITE, BLACK); //กำหนดข้อความสีขาว ฉากหลังสีดำ
  OLED.setCursor(0, 0); // กำหนดตำแหน่ง x,y ที่จะแสดงผล
  OLED.setTextSize(2); // กำหนดขนาดตัวอักษร
  OLED.println("CRD METER"); // แสดงผลข้อความ ALL

  OLED.display(); // สั่งให้จอแสดงผล
  delay(1500);
  OLED.clearDisplay(); // ลบภาพในหน้าจอทั้งหมด

  OLED.display(); // สั่งให้จอแสดงผล
  OLED.drawBitmap(0, 0,  myBitmap, 128, 64, WHITE);
  OLED.display();
  delay(3000);
  OLED.clearDisplay(); // ลบภาพในหน้าจอทั้งหมด

  OLED.display(); // สั่งให้จอแสดงผล
}

void loop()
{
  raw = analogRead(analogPin);
  if (raw)
  {
    buffer = raw * Vin;
    Vout = (buffer) / 1024.0;
    buffer = (Vin / Vout) - 1;
    R2 = R1 * buffer;
    Vdow = Vout - 5;
    Serial.print("Vout: ");
    Serial.println(Vout);
    Serial.print("R2: ");
    Serial.println(R2);

  }
  if (digitalRead(bt) == HIGH) {
    delay(10);
    if (digitalRead(bt) == LOW) {
      i += 1;
    }
  }
  if (i == 1) {
    OLED.setTextColor(WHITE, BLACK); //กำหนดข้อความสีขาว ฉากหลังสีดำ
    OLED.setCursor(0, 0); // กำหนดตำแหน่ง x,y ที่จะแสดงผล
    OLED.setTextSize(2); // กำหนดขนาดตัวอักษร
    OLED.println("OHM METER"); // แสดงผลข้อความ ALL
    OLED.setCursor(0, 20); // กำหนดตำแหน่ง x,y ที่จะแสดงผล
    OLED.setTextSize(1); // กำหนดขนาดตัวอักษร
    OLED.println(Vout); // แสดงผลข้อความ ALL
    OLED.setCursor(27, 20); // กำหนดตำแหน่ง x,y ที่จะแสดงผล
    OLED.setTextSize(1); // กำหนดขนาดตัวอักษร
    OLED.println("V"); // แสดงผลข้อความ ALL
    OLED.setCursor(0, 40); // กำหนดตำแหน่ง x,y ที่จะแสดงผล
    OLED.setTextSize(2); // กำหนดขนาดตัวอักษร
    OLED.println(R2); // แสดงผลข้อความ ALL
    OLED.setCursor(70, 40); // กำหนดตำแหน่ง x,y ที่จะแสดงผล
    OLED.setTextSize(2); // กำหนดขนาดตัวอักษร
    OLED.println("OHM"); // แสดงผลข้อความ ALL
    OLED.setCursor(50, 20); // กำหนดตำแหน่ง x,y ที่จะแสดงผล
    OLED.setTextSize(1); // กำหนดขนาดตัวอักษร
    OLED.println(Vdow); // แสดงผลข้อความ ALL
    OLED.setCursor(78, 20); // กำหนดตำแหน่ง x,y ที่จะแสดงผล
    OLED.setTextSize(1); // กำหนดขนาดตัวอักษร
    OLED.println("V"); // แสดงผลข้อความ ALL
    
    OLED.display(); // สั่งให้จอแสดงผล
    delay(10);
  }
}
